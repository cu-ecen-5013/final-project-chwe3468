## RPi4_base/base_external/Config.in
```kconfig
source "$BR2_EXTERNAL_project_base_PATH/package/aesd-cam/Config.in"
source "$BR2_EXTERNAL_project_base_PATH/package/aesd-cam-client/Config.in"
```

## RPi4_base/base_external/package/aesd-cam-client/Config.in
```kconfig
config BR2_PACKAGE_AESD_CAM_CLIENT
	bool "aesd-cam-client"
	help
	  Includes the function that capture image and save it as ppm format and send it server over socket using TCP protocol
```
